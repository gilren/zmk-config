&i2c1 {
    status = "okay";

    ssd1306: ssd1306@3C {
        compatible = "solomon,ssd1306fb";
        reg = <0x3C>;
        width = <128>;
        height = <64>;
        segment-offset = <0>;
        page-offset = <0>;
        display-offset = <0>;
        multiplex-ratio = <63>;
        segment-remap;
        com-invdir;
        prechargep = <0x22>;
        reset-gpios = <&gpio0 2 GPIO_ACTIVE_LOW>;
    };
};
