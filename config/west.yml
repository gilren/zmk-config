## config/west.yml
```yaml
manifest:
  defaults:
    remote: urob
    revision: v0.2 # Pin everything to v0.2
  remotes:
    - name: zmkfirmware
      url-base: https://github.com/zmkfirmware
    - name: urob
      url-base: https://github.com/urob
  projects:
    - name: zmk
      remote: zmkfirmware
      revision: main
      import: app/west.yml

    # ZMK modules
    - name: zmk-auto-layer
      path: modules/zmk/auto-layer
    - name: zmk-helpers
      path: modules/zmk/helpers
    - name: zmk-tri-state
      path: modules/zmk/tri-state
  self:
    path: config
```
